#include "ergonaut_one.dtsi"

/* The dongle has no matrix; this keeps the shared 42-position transform
 * available for the keymap while all real key events arrive over split BLE. */
&kscan0 {
    col-gpios = <&xiao_d 0 GPIO_ACTIVE_HIGH>, <&xiao_d 1 GPIO_ACTIVE_HIGH>,
                <&xiao_d 2 GPIO_ACTIVE_HIGH>, <&xiao_d 3 GPIO_ACTIVE_HIGH>,
                <&xiao_d 4 GPIO_ACTIVE_HIGH>, <&xiao_d 5 GPIO_ACTIVE_HIGH>;
};
