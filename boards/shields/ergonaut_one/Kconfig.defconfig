## boards/shields/ergonaut_one/Kconfig.defconfig
```kconfig
# SPDX-License-Identifier: MIT

if SHIELD_ERGONAUT_ONE_LEFT || SHIELD_ERGONAUT_ONE_DONGLE

config ZMK_KEYBOARD_NAME
    default "Ergonaut One"

config ZMK_SPLIT_ROLE_CENTRAL
    default y

endif

if SHIELD_ERGONAUT_ONE_DONGLE

config ZMK_SPLIT_BLE_CENTRAL_PERIPHERALS
    default 2

endif

if SHIELD_ERGONAUT_ONE_LEFT || SHIELD_ERGONAUT_ONE_RIGHT || SHIELD_ERGONAUT_ONE_DONGLE

config ZMK_SPLIT
    default y

endif
```

## boards/shields/ergonaut_one/Kconfig.shield
```kconfig
# Copyright (c) 2020 The ZMK Contributors
# SPDX-License-Identifier: MIT

config SHIELD_ERGONAUT_ONE_LEFT
    def_bool $(shields_list_contains,ergonaut_ont_left)

config SHIELD_ERGONAUT_ONE_RIGHT
    def_bool $(shields_list_contains,ergonaut_ont_right)

config SHIELD_ERGONAUT_ONE_DONGLE
    def_bool $(shields_list_contains,ergonaut_ont_dongle)
```

## config/boards/shields/ergonaut_one/Kconfig.shield
```kconfig
# Copyright (c) 2020 The ZMK Contributors
# SPDX-License-Identifier: MIT

config SHIELD_ERGONAUT_ONE_DONGLE
    def_bool $(shields_list_contains,ergonaut_one_dongle)
```

## config/west.yml
```yaml
manifest:
  remotes:
    - name: zmkfirmware
      url-base: https://github.com/zmkfirmware
    - name: urob
      url-base: https://github.com/urob
    - name: ergonautkb
      url-base: https://github.com/ergonautkb
  projects:
    - name: zmk
      remote: zmkfirmware
      revision: main
      import: app/west.yml
    - name: zmk-helpers
      remote: urob
      revision: main
    - name: ergonautkb-zmk-module
      remote: ergonautkb
      revision: main
  self:
    path: config
```
